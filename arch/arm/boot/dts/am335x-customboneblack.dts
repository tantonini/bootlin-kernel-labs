#include "am335x-boneblack.dts"

&am33xx_pinmux {
	i2c1_pins: pinmux_i2c1_pins {
		pinctrl-single,pins = <
			AM33XX_PADCONF(AM335X_PIN_SPI0_CS0,  PIN_INPUT_PULLUP, MUX_MODE2)		/* spio0_cs1.i2c1_scl */
			AM33XX_PADCONF(AM335X_PIN_SPI0_D1,  PIN_INPUT_PULLUP, MUX_MODE2)		/* spio0_d1.i2c1_sda */
		>;
	};
};

&i2c1 {
	pinctrl-names = "default";
	pinctrl-0 = <&i2c1_pins>;

	status = "okay";
	clock-frequency = <100000>;

	joystick: joystick@52 {
		compatible = "nintendo,nunchuk";
		reg = <0x52>;
	};
};
